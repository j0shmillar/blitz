## CMakeLists.txt
```
cmake_minimum_required(VERSION 3.5)
project(blitz)

set(CMAKE_CXX_STANDARD 17)
set(CMAKE_CXX_STANDARD_REQUIRED ON)
set(CMAKE_CXX_EXTENSIONS OFF)

# using tflite-micro version 240120 https://github.com/tensorflow/tflite-micro/tree/324ae1eaba98c8aeb440072371efea481c42ace3

option(USE_STATIC_MEMORY "" ON)
message(USE_STATIC_MEMORY=${USE_STATIC_MEMORY})
message(CMAKE_BUILD_TYPE=${CMAKE_BUILD_TYPE})
set(tflm_src_dir ${CMAKE_CURRENT_SOURCE_DIR}/tflite_micro)
set(tflm_tflite_dir "${tflm_src_dir}/tensorflow/lite")
set(tflm_signal_dir "${tflm_src_dir}/signal")
set(tflm_micro_dir "${tflm_tflite_dir}/micro")
set(tflm_frontend_dir "${tflm_tflite_dir}/experimental/microfrontend/lib")
set(tflm_kernels_dir "${tflm_micro_dir}/kernels")

file(GLOB tflm_micro_src
    "${tflm_micro_dir}/*.cc"
    "${tflm_micro_dir}/*.c"
)

file(GLOB tflm_frontend_src
    "${tflm_frontend_dir}/*.c"
    "${tflm_frontend_dir}/*.cc"
)

file(GLOB tflm_bridge_src
    "${tflm_micro_dir}/tflite_bridge/*.c"
    "${tflm_micro_dir}/tflite_bridge/*.cc"
)

file(GLOB tflm_kernels_src
    "${tflm_kernels_dir}/*.c"
    "${tflm_kernels_dir}/*.cc"
)

file(GLOB tflm_signalkernels_src
    "${tflm_signal_dir}/micro/kernels/*.c"
    "${tflm_signal_dir}/micro/kernels/*.cc"
)

file(GLOB tflm_signal_src
    "${tflm_signal_dir}/src/*.c"
    "${tflm_signal_dir}/src/*.cc"
)

set(tflm_signalall_src
    "${tflm_signalkernels_src}"
    "${tflm_signal_src}"
    "${tflm_signal_dir}/src/kiss_fft_wrappers/kiss_fft_float.cc"
    "${tflm_signal_dir}/src/kiss_fft_wrappers/kiss_fft_int16.cc"
    "${tflm_signal_dir}/src/kiss_fft_wrappers/kiss_fft_int32.cc"
)

set(tflm_all_src
    "${tflm_micro_src}"
    "${tflm_kernels_src}"
    "${tflm_bridge_src}"
    "${esp_nn_kernels}"
    "${tflm_frontend_src}"
    "${tflm_signalall_src}"
    "${tflm_tflite_dir}/kernels/kernel_util.cc"
    "${tflm_tflite_dir}/micro/memory_planner/greedy_memory_planner.cc"
    "${tflm_tflite_dir}/micro/memory_planner/linear_memory_planner.cc"
    "${tflm_tflite_dir}/micro/arena_allocator/non_persistent_arena_buffer_allocator.cc"
    "${tflm_tflite_dir}/micro/arena_allocator/persistent_arena_buffer_allocator.cc"
    "${tflm_tflite_dir}/micro/arena_allocator/recording_single_arena_buffer_allocator.cc"
    "${tflm_tflite_dir}/micro/arena_allocator/single_arena_buffer_allocator.cc"
    "${tflm_tflite_dir}/core/c/common.cc"
    "${tflm_tflite_dir}/core/api/error_reporter.cc"
    "${tflm_tflite_dir}/core/api/flatbuffer_conversions.cc"
    "${tflm_tflite_dir}/core/api/tensor_utils.cc"
    "${tflm_tflite_dir}/kernels/internal/common.cc"
    "${tflm_tflite_dir}/kernels/internal/quantization_util.cc"
    "${tflm_tflite_dir}/kernels/internal/portable_tensor_utils.cc"
    "${tflm_tflite_dir}/kernels/internal/tensor_utils.cc"
    "${tflm_tflite_dir}/kernels/internal/tensor_ctypes.cc"
    "${tflm_tflite_dir}/kernels/internal/reference/portable_tensor_utils.cc"
    "${tflm_tflite_dir}/kernels/internal/reference/comparisons.cc"
    "${tflm_tflite_dir}/schema/schema_utils.cc"
)
set(tflm_all_include     
    ${tflm_src_dir}
    ${tflm_src_dir}/third_party/flatbuffers/include
    ${tflm_src_dir}/third_party/gemmlowp
    ${tflm_src_dir}/third_party/kissfft
    ${tflm_src_dir}/third_party/ruy
    CACHE INTERNAL ""
)

if(MSVC)
    list(REMOVE_ITEM tflm_all_src ${tflm_tflite_dir}/micro/test_helpers.cc)
else()
    set(tflm_c_flags ${tflm_c_flags} -DTF_LITE_DISABLE_X86_NEON
        -Wstrict-aliasing -Wno-unused-parameter -Wno-null-dereference
        -Wno-unused-but-set-variable -Wno-unused-function -Wno-shadow
        -Wsign-compare -Wdouble-promotion -Wswitch 
        -Wmissing-field-initializers -ffunction-sections -fdata-sections
        -fno-unwind-tables -fmessage-length=0
    )
    set(tflm_cxx_flags ${tflm_c_flags} 
        -fno-rtti -fno-exceptions -fno-threadsafe-statics
        -Werror -Wno-return-type -Wno-strict-aliasing
    )
endif()

if (USE_STATIC_MEMORY)
    set(tflm_c_flags ${tflm_c_flags} -DTF_LITE_STATIC_MEMORY)
    set(CMAKE_CXX_STANDARD 11)
else()
    list(APPEND tflm_all_src "${tflm_tflite_dir}/array.cc")
    set(CMAKE_CXX_STANDARD 17)
endif()

if(CMAKE_BUILD_TYPE MATCHES "Debug")
    set(tflm_c_flags -g ${tflm_c_flags})
else()
    set(tflm_c_flags -O3 ${tflm_c_flags})
endif()

if (WIN32)
    set(CMAKE_CXX_STANDARD 17)
endif()

add_library(tflm STATIC ${tflm_all_src})
target_include_directories(tflm PRIVATE ${tflm_all_include})   
target_compile_options(tflm PRIVATE 
    ${tflm_c_flags} 
)
target_compile_options(tflm PRIVATE 
    $<$<COMPILE_LANGUAGE:CXX>: ${tflm_cxx_flags}>
)

add_executable(main src/main.cpp)
target_compile_features(main PRIVATE cxx_std_17)
target_include_directories(main PRIVATE ${tflm_all_include})
target_link_libraries(main PRIVATE tflm)
```

## prj.conf
```kconfig
# Copyright 2019 The TensorFlow Authors. All Rights Reserved.
#
# Licensed under the Apache License, Version 2.0 (the "License");
# you may not use this file except in compliance with the License.
# You may obtain a copy of the License at
#
#    http://www.apache.org/licenses/LICENSE-2.0
#
# Unless required by applicable law or agreed to in writing, software
# distributed under the License is distributed on an "AS IS" BASIS,
# WITHOUT WARRANTIES OR CONDITIONS OF ANY KIND, either express or implied.
# See the License for the specific language governing permissions and
# limitations under the License.
# ==============================================================================s
CONFIG_CPP=y
CONFIG_STD_CPP17=y
CONFIG_MAIN_STACK_SIZE=2048
CONFIG_REQUIRES_FULL_LIBC=y
CONFIG_TENSORFLOW_LITE_MICRO=y
```

## src/main.cpp
```c
#include <stdio.h>
#include <stdlib.h>
#include <sys/time.h>
#include <unistd.h>
#include "model.h"
#include "tensorflow/lite/micro/micro_mutable_op_resolver.h"
#include "tensorflow/lite/micro/micro_interpreter.h"
#include "tensorflow/lite/schema/schema_generated.h"

#define INPUT_SIZE 784  
#define OUTPUT_SIZE 10 
#define NUM_RUNS 10
#define DELAY_BETWEEN_INFERENCES 10

namespace {
  constexpr int kTensorArenaSize = 10 * 1024;
  uint8_t tensor_arena[kTensorArenaSize];
}

int main() {
    const tflite::Model* model = tflite::GetModel(model_data);
    if (model->version() != TFLITE_SCHEMA_VERSION) {
        fprintf(stderr, "Model provided is version %d not equal to supported version %d.\n", model->version(), TFLITE_SCHEMA_VERSION);
        return 1;
    }

    tflite::MicroMutableOpResolver<10> resolver;  // Use MicroMutableOpResolver
    tflite::MicroInterpreter interpreter(model, resolver, tensor_arena, kTensorArenaSize);
    interpreter.AllocateTensors();

    TfLiteTensor* input = interpreter.input(0);
    TfLiteTensor* output = interpreter.output(0);

    struct timeval start_time, end_time;
    double latencies[NUM_RUNS];

    for (int i = 0; i < NUM_RUNS; ++i) {
        for (int j = 0; j < INPUT_SIZE; ++j) {
            input->data.f[j] = (float)rand() / RAND_MAX;
        }

        gettimeofday(&start_time, NULL);
        TfLiteStatus invoke_status = interpreter.Invoke();
        gettimeofday(&end_time, NULL);

        if (invoke_status != kTfLiteOk) {
            fprintf(stderr, "Invoke failed\n");
            return 1;
        }

        double latency_ms = (double)(end_time.tv_sec - start_time.tv_sec) * 1000.0 + (double)(end_time.tv_usec - start_time.tv_usec) / 1000.0;
        latencies[i] = latency_ms;

        usleep((useconds_t)(DELAY_BETWEEN_INFERENCES * 1000000));  // Ensure <unistd.h> is included
    }

    double total_time = 0.0;
    for (int i = 0; i < NUM_RUNS; ++i) {
        total_time += latencies[i];
    }
    double average_latency = total_time / NUM_RUNS;
    double throughput = NUM_RUNS / (total_time / 1000.0);

    printf("Average Latency: %.2f ms\n", average_latency);
    printf("Throughput: %.2f inferences/second\n", throughput);

    return 0;
}
```

## src/main_template.cpp
```c
#include <stdio.h>
#include <stdlib.h>
#include <sys/time.h>
#include <unistd.h>
#include "model.h"
#include "tensorflow/lite/micro/micro_mutable_op_resolver.h"
#include "tensorflow/lite/micro/micro_interpreter.h"
#include "tensorflow/lite/schema/schema_generated.h"

#define INPUT_SIZE {input_size}  
#define OUTPUT_SIZE {output_size} 
#define NUM_RUNS {num_inferences}
#define DELAY_BETWEEN_INFERENCES {inference_seconds}

namespace {
  constexpr int kTensorArenaSize = 10 * 1024;
  uint8_t tensor_arena[kTensorArenaSize];
}

int main() {
    const tflite::Model* model = tflite::GetModel(model_data);
    if (model->version() != TFLITE_SCHEMA_VERSION) {
        fprintf(stderr, "Model provided is version %d not equal to supported version %d.\n", model->version(), TFLITE_SCHEMA_VERSION);
        return 1;
    }

    tflite::MicroMutableOpResolver<10> resolver; 
    tflite::MicroInterpreter interpreter(model, resolver, tensor_arena, kTensorArenaSize);
    interpreter.AllocateTensors();

    TfLiteTensor* input = interpreter.input(0);
    TfLiteTensor* output = interpreter.output(0);

    struct timeval start_time, end_time;
    double latencies[NUM_RUNS];

    for (int i = 0; i < NUM_RUNS; ++i) {
        for (int j = 0; j < INPUT_SIZE; ++j) {
            input->data.f[j] = (float)rand() / RAND_MAX;
        }

        gettimeofday(&start_time, NULL);
        TfLiteStatus invoke_status = interpreter.Invoke();
        gettimeofday(&end_time, NULL);

        if (invoke_status != kTfLiteOk) {
            fprintf(stderr, "Invoke failed\n");
            return 1;
        }

        double latency_ms = (double)(end_time.tv_sec - start_time.tv_sec) * 1000.0 + (double)(end_time.tv_usec - start_time.tv_usec) / 1000.0;
        latencies[i] = latency_ms;

        usleep((useconds_t)(DELAY_BETWEEN_INFERENCES * 1000000)); 
    }

    double total_time = 0.0;
    for (int i = 0; i < NUM_RUNS; ++i) {
        total_time += latencies[i];
    }
    double average_latency = total_time / NUM_RUNS;
    double throughput = NUM_RUNS / (total_time / 1000.0);

    printf("Average Latency: %.2f ms\n", average_latency);
    printf("Throughput: %.2f inferences/second\n", throughput);

    return 0;
}
```
