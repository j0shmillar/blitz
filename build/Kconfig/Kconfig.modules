## build/Kconfig/Kconfig.modules
```kconfig
menu "tflite-micro (/Users/joshmillar/Desktop/phd/blitz/optional/modules/lib/tflite-micro)"
osource "$(ZEPHYR_TFLITE_MICRO_KCONFIG)"
config ZEPHYR_TFLITE_MICRO_MODULE
	bool
	default y
endmenu
menu "acpica (/Users/joshmillar/Desktop/phd/blitz/modules/lib/acpica)"
osource "$(ZEPHYR_ACPICA_KCONFIG)"
config ZEPHYR_ACPICA_MODULE
	bool
	default y
endmenu
menu "cmsis (/Users/joshmillar/Desktop/phd/blitz/modules/hal/cmsis)"
osource "$(ZEPHYR_CMSIS_KCONFIG)"
config ZEPHYR_CMSIS_MODULE
	bool
	default y
endmenu
menu "cmsis-dsp (/Users/joshmillar/Desktop/phd/blitz/modules/lib/cmsis-dsp)"
osource "$(ZEPHYR_CMSIS_DSP_KCONFIG)"
config ZEPHYR_CMSIS_DSP_MODULE
	bool
	default y
endmenu
menu "cmsis-nn (/Users/joshmillar/Desktop/phd/blitz/modules/lib/cmsis-nn)"
osource "$(ZEPHYR_CMSIS_NN_KCONFIG)"
config ZEPHYR_CMSIS_NN_MODULE
	bool
	default y
endmenu
menu "fatfs (/Users/joshmillar/Desktop/phd/blitz/modules/fs/fatfs)"
osource "$(ZEPHYR_FATFS_KCONFIG)"
config ZEPHYR_FATFS_MODULE
	bool
	default y
endmenu
config ZEPHYR_ADI_MODULE
   bool
   default y
config ZEPHYR_ALTERA_MODULE
   bool
   default y
menu "hal_ambiq (/Users/joshmillar/Desktop/phd/blitz/modules/hal/ambiq)"
osource "$(ZEPHYR_HAL_AMBIQ_KCONFIG)"
config ZEPHYR_HAL_AMBIQ_MODULE
	bool
	default y
endmenu
config ZEPHYR_ATMEL_MODULE
   bool
   default y
menu "hal_espressif (/Users/joshmillar/Desktop/phd/blitz/modules/hal/espressif)"
osource "/Users/joshmillar/Desktop/phd/blitz/modules/hal/espressif/zephyr/Kconfig"
config ZEPHYR_HAL_ESPRESSIF_MODULE
	bool
	default y
endmenu
menu "hal_ethos_u (/Users/joshmillar/Desktop/phd/blitz/modules/hal/ethos_u)"
osource "$(ZEPHYR_HAL_ETHOS_U_KCONFIG)"
config ZEPHYR_HAL_ETHOS_U_MODULE
	bool
	default y
endmenu
menu "hal_gigadevice (/Users/joshmillar/Desktop/phd/blitz/modules/hal/gigadevice)"
osource "$(ZEPHYR_HAL_GIGADEVICE_KCONFIG)"
config ZEPHYR_HAL_GIGADEVICE_MODULE
	bool
	default y
endmenu
menu "hal_infineon (/Users/joshmillar/Desktop/phd/blitz/modules/hal/infineon)"
osource "$(ZEPHYR_HAL_INFINEON_KCONFIG)"
config ZEPHYR_HAL_INFINEON_MODULE
	bool
	default y
endmenu
menu "hal_intel (/Users/joshmillar/Desktop/phd/blitz/modules/hal/intel)"
osource "/Users/joshmillar/Desktop/phd/blitz/modules/hal/intel/zephyr/Kconfig"
config ZEPHYR_HAL_INTEL_MODULE
	bool
	default y
endmenu
config ZEPHYR_MICROCHIP_MODULE
   bool
   default y
menu "hal_nordic (/Users/joshmillar/Desktop/phd/blitz/modules/hal/nordic)"
osource "$(ZEPHYR_HAL_NORDIC_KCONFIG)"
config ZEPHYR_HAL_NORDIC_MODULE
	bool
	default y
endmenu
config ZEPHYR_NUVOTON_MODULE
   bool
   default y
menu "hal_nxp (/Users/joshmillar/Desktop/phd/blitz/modules/hal/nxp)"
osource "$(ZEPHYR_HAL_NXP_KCONFIG)"
config ZEPHYR_HAL_NXP_MODULE
	bool
	default y
endmenu
config ZEPHYR_OPENISA_MODULE
   bool
   default y
config ZEPHYR_QUICKLOGIC_MODULE
   bool
   default y
config ZEPHYR_HAL_RENESAS_MODULE
   bool
   default y
menu "hal_rpi_pico (/Users/joshmillar/Desktop/phd/blitz/modules/hal/rpi_pico)"
osource "$(ZEPHYR_HAL_RPI_PICO_KCONFIG)"
config ZEPHYR_HAL_RPI_PICO_MODULE
	bool
	default y
endmenu
menu "hal_silabs (/Users/joshmillar/Desktop/phd/blitz/modules/hal/silabs)"
osource "/Users/joshmillar/Desktop/phd/blitz/modules/hal/silabs/zephyr/Kconfig"
config ZEPHYR_HAL_SILABS_MODULE
	bool
	default y
endmenu
menu "hal_st (/Users/joshmillar/Desktop/phd/blitz/modules/hal/st)"
osource "$(ZEPHYR_HAL_ST_KCONFIG)"
config ZEPHYR_HAL_ST_MODULE
	bool
	default y
endmenu
config ZEPHYR_STM32_MODULE
   bool
   default y
menu "hal_telink (/Users/joshmillar/Desktop/phd/blitz/modules/hal/telink)"
osource "/Users/joshmillar/Desktop/phd/blitz/modules/hal/telink/Kconfig"
config ZEPHYR_HAL_TELINK_MODULE
	bool
	default y
endmenu
config ZEPHYR_TI_MODULE
   bool
   default y
config ZEPHYR_HAL_WURTHELEKTRONIK_MODULE
   bool
   default y
config ZEPHYR_XTENSA_MODULE
   bool
   default y
menu "hostap (/Users/joshmillar/Desktop/phd/blitz/modules/lib/hostap)"
osource "$(ZEPHYR_HOSTAP_KCONFIG)"
config ZEPHYR_HOSTAP_MODULE
	bool
	default y
endmenu
config ZEPHYR_LIBMETAL_MODULE
   bool
   default y
menu "liblc3 (/Users/joshmillar/Desktop/phd/blitz/modules/lib/liblc3)"
osource "$(ZEPHYR_LIBLC3_KCONFIG)"
config ZEPHYR_LIBLC3_MODULE
	bool
	default y
endmenu
menu "littlefs (/Users/joshmillar/Desktop/phd/blitz/modules/fs/littlefs)"
osource "$(ZEPHYR_LITTLEFS_KCONFIG)"
config ZEPHYR_LITTLEFS_MODULE
	bool
	default y
endmenu
menu "loramac-node (/Users/joshmillar/Desktop/phd/blitz/modules/lib/loramac-node)"
osource "$(ZEPHYR_LORAMAC_NODE_KCONFIG)"
config ZEPHYR_LORAMAC_NODE_MODULE
	bool
	default y
endmenu
menu "lvgl (/Users/joshmillar/Desktop/phd/blitz/modules/lib/gui/lvgl)"
osource "/Users/joshmillar/Desktop/phd/blitz/modules/lib/gui/lvgl/Kconfig"
config ZEPHYR_LVGL_MODULE
	bool
	default y
endmenu
config ZEPHYR_MCUBOOT_MODULE
   bool
   default y
config ZEPHYR_MIPI_SYS_T_MODULE
   bool
   default y
config ZEPHYR_NRF_HW_MODELS_MODULE
   bool
   default y
config ZEPHYR_OPEN_AMP_MODULE
   bool
   default y
menu "percepio (/Users/joshmillar/Desktop/phd/blitz/modules/debug/percepio)"
osource "/Users/joshmillar/Desktop/phd/blitz/modules/debug/percepio/zephyr/Kconfig"
config ZEPHYR_PERCEPIO_MODULE
	bool
	default y
endmenu
menu "segger (/Users/joshmillar/Desktop/phd/blitz/modules/debug/segger)"
osource "$(ZEPHYR_SEGGER_KCONFIG)"
config ZEPHYR_SEGGER_MODULE
	bool
	default y
endmenu
menu "uoscore-uedhoc (/Users/joshmillar/Desktop/phd/blitz/modules/lib/uoscore-uedhoc)"
osource "$(ZEPHYR_UOSCORE_UEDHOC_KCONFIG)"
config ZEPHYR_UOSCORE_UEDHOC_MODULE
	bool
	default y
endmenu
menu "zcbor (/Users/joshmillar/Desktop/phd/blitz/modules/lib/zcbor)"
osource "$(ZEPHYR_ZCBOR_KCONFIG)"
config ZEPHYR_ZCBOR_MODULE
	bool
	default y
endmenu
```

## build/Kconfig/arch/Kconfig
```kconfig
# Load arch Kconfig descriptions.
osource "/Users/joshmillar/Desktop/phd/blitz/zephyr/arch/x86/Kconfig"
osource "/Users/joshmillar/Desktop/phd/blitz/zephyr/arch/xtensa/Kconfig"
osource "/Users/joshmillar/Desktop/phd/blitz/zephyr/arch/sparc/Kconfig"
osource "/Users/joshmillar/Desktop/phd/blitz/zephyr/arch/riscv/Kconfig"
osource "/Users/joshmillar/Desktop/phd/blitz/zephyr/arch/posix/Kconfig"
osource "/Users/joshmillar/Desktop/phd/blitz/zephyr/arch/nios2/Kconfig"
osource "/Users/joshmillar/Desktop/phd/blitz/zephyr/arch/mips/Kconfig"
osource "/Users/joshmillar/Desktop/phd/blitz/zephyr/arch/arm64/Kconfig"
osource "/Users/joshmillar/Desktop/phd/blitz/zephyr/arch/arm/Kconfig"
osource "/Users/joshmillar/Desktop/phd/blitz/zephyr/arch/arc/Kconfig"
```

## build/Kconfig/soc/Kconfig
```kconfig
# Load Zephyr SoC Kconfig descriptions.
osource "/Users/joshmillar/Desktop/phd/blitz/zephyr/soc/xlnx/zynqmp/Kconfig"
osource "/Users/joshmillar/Desktop/phd/blitz/zephyr/soc/xlnx/zynq7000/Kconfig"
osource "/Users/joshmillar/Desktop/phd/blitz/zephyr/soc/xen/Kconfig"
osource "/Users/joshmillar/Desktop/phd/blitz/zephyr/soc/ti/simplelink/Kconfig"
osource "/Users/joshmillar/Desktop/phd/blitz/zephyr/soc/ti/lm3s6965/Kconfig"
osource "/Users/joshmillar/Desktop/phd/blitz/zephyr/soc/ti/k3/Kconfig"
osource "/Users/joshmillar/Desktop/phd/blitz/zephyr/soc/telink/tlsr/Kconfig"
osource "/Users/joshmillar/Desktop/phd/blitz/zephyr/soc/starfive/jh71xx/Kconfig"
osource "/Users/joshmillar/Desktop/phd/blitz/zephyr/soc/st/stm32/Kconfig"
osource "/Users/joshmillar/Desktop/phd/blitz/zephyr/soc/snps/qemu_arc/Kconfig"
osource "/Users/joshmillar/Desktop/phd/blitz/zephyr/soc/snps/nsim/arc_v/Kconfig"
osource "/Users/joshmillar/Desktop/phd/blitz/zephyr/soc/snps/nsim/arc_classic/Kconfig"
osource "/Users/joshmillar/Desktop/phd/blitz/zephyr/soc/snps/hsdk4xd/Kconfig"
osource "/Users/joshmillar/Desktop/phd/blitz/zephyr/soc/snps/hsdk/Kconfig"
osource "/Users/joshmillar/Desktop/phd/blitz/zephyr/soc/snps/emsk/Kconfig"
osource "/Users/joshmillar/Desktop/phd/blitz/zephyr/soc/snps/emsdp/Kconfig"
osource "/Users/joshmillar/Desktop/phd/blitz/zephyr/soc/snps/arc_iot/Kconfig"
osource "/Users/joshmillar/Desktop/phd/blitz/zephyr/soc/silabs/Kconfig"
osource "/Users/joshmillar/Desktop/phd/blitz/zephyr/soc/sifive/sifive_freedom/Kconfig"
osource "/Users/joshmillar/Desktop/phd/blitz/zephyr/soc/rockchip/Kconfig"
osource "/Users/joshmillar/Desktop/phd/blitz/zephyr/soc/renode/riscv_virtual/Kconfig"
osource "/Users/joshmillar/Desktop/phd/blitz/zephyr/soc/renesas/smartbond/Kconfig"
osource "/Users/joshmillar/Desktop/phd/blitz/zephyr/soc/renesas/rzt2m/Kconfig"
osource "/Users/joshmillar/Desktop/phd/blitz/zephyr/soc/renesas/rcar/Kconfig"
osource "/Users/joshmillar/Desktop/phd/blitz/zephyr/soc/renesas/ra/Kconfig"
osource "/Users/joshmillar/Desktop/phd/blitz/zephyr/soc/raspberrypi/Kconfig"
osource "/Users/joshmillar/Desktop/phd/blitz/zephyr/soc/quicklogic/eos_s3/Kconfig"
osource "/Users/joshmillar/Desktop/phd/blitz/zephyr/soc/qemu/virt_riscv/Kconfig"
osource "/Users/joshmillar/Desktop/phd/blitz/zephyr/soc/qemu/malta/Kconfig"
osource "/Users/joshmillar/Desktop/phd/blitz/zephyr/soc/openisa/rv32m1/Kconfig"
osource "/Users/joshmillar/Desktop/phd/blitz/zephyr/soc/nxp/s32/Kconfig"
osource "/Users/joshmillar/Desktop/phd/blitz/zephyr/soc/nxp/rw/Kconfig"
osource "/Users/joshmillar/Desktop/phd/blitz/zephyr/soc/nxp/mcx/Kconfig"
osource "/Users/joshmillar/Desktop/phd/blitz/zephyr/soc/nxp/lpc/Kconfig"
osource "/Users/joshmillar/Desktop/phd/blitz/zephyr/soc/nxp/layerscape/Kconfig"
osource "/Users/joshmillar/Desktop/phd/blitz/zephyr/soc/nxp/kinetis/Kconfig"
osource "/Users/joshmillar/Desktop/phd/blitz/zephyr/soc/nxp/imxrt/Kconfig"
osource "/Users/joshmillar/Desktop/phd/blitz/zephyr/soc/nxp/imx/Kconfig"
osource "/Users/joshmillar/Desktop/phd/blitz/zephyr/soc/nuvoton/numicro/Kconfig"
osource "/Users/joshmillar/Desktop/phd/blitz/zephyr/soc/nuvoton/numaker/Kconfig"
osource "/Users/joshmillar/Desktop/phd/blitz/zephyr/soc/nuvoton/npcx/Kconfig"
osource "/Users/joshmillar/Desktop/phd/blitz/zephyr/soc/nordic/Kconfig"
osource "/Users/joshmillar/Desktop/phd/blitz/zephyr/soc/neorv32/Kconfig"
osource "/Users/joshmillar/Desktop/phd/blitz/zephyr/soc/native/inf_clock/Kconfig"
osource "/Users/joshmillar/Desktop/phd/blitz/zephyr/soc/microchip/miv/Kconfig"
osource "/Users/joshmillar/Desktop/phd/blitz/zephyr/soc/microchip/mec/Kconfig"
osource "/Users/joshmillar/Desktop/phd/blitz/zephyr/soc/mediatek/mtk_adsp/Kconfig"
osource "/Users/joshmillar/Desktop/phd/blitz/zephyr/soc/lowrisc/opentitan/Kconfig"
osource "/Users/joshmillar/Desktop/phd/blitz/zephyr/soc/litex/litex_vexriscv/Kconfig"
osource "/Users/joshmillar/Desktop/phd/blitz/zephyr/soc/ite/ec/Kconfig"
osource "/Users/joshmillar/Desktop/phd/blitz/zephyr/soc/intel/raptor_lake/Kconfig"
osource "/Users/joshmillar/Desktop/phd/blitz/zephyr/soc/intel/lakemont/Kconfig"
osource "/Users/joshmillar/Desktop/phd/blitz/zephyr/soc/intel/intel_socfpga_std/Kconfig"
osource "/Users/joshmillar/Desktop/phd/blitz/zephyr/soc/intel/intel_socfpga/Kconfig"
osource "/Users/joshmillar/Desktop/phd/blitz/zephyr/soc/intel/intel_niosv/Kconfig"
osource "/Users/joshmillar/Desktop/phd/blitz/zephyr/soc/intel/intel_ish/Kconfig"
osource "/Users/joshmillar/Desktop/phd/blitz/zephyr/soc/intel/intel_adsp/Kconfig"
osource "/Users/joshmillar/Desktop/phd/blitz/zephyr/soc/intel/elkhart_lake/Kconfig"
osource "/Users/joshmillar/Desktop/phd/blitz/zephyr/soc/intel/atom/Kconfig"
osource "/Users/joshmillar/Desktop/phd/blitz/zephyr/soc/intel/apollo_lake/Kconfig"
osource "/Users/joshmillar/Desktop/phd/blitz/zephyr/soc/intel/alder_lake/Kconfig"
osource "/Users/joshmillar/Desktop/phd/blitz/zephyr/soc/infineon/cat3/Kconfig"
osource "/Users/joshmillar/Desktop/phd/blitz/zephyr/soc/infineon/cat1b/Kconfig"
osource "/Users/joshmillar/Desktop/phd/blitz/zephyr/soc/infineon/cat1a/Kconfig"
osource "/Users/joshmillar/Desktop/phd/blitz/zephyr/soc/gd/gd32/Kconfig"
osource "/Users/joshmillar/Desktop/phd/blitz/zephyr/soc/gaisler/leon3/Kconfig"
osource "/Users/joshmillar/Desktop/phd/blitz/zephyr/soc/gaisler/gr716a/Kconfig"
osource "/Users/joshmillar/Desktop/phd/blitz/zephyr/soc/espressif/Kconfig"
osource "/Users/joshmillar/Desktop/phd/blitz/zephyr/soc/ene/kb1200/Kconfig"
osource "/Users/joshmillar/Desktop/phd/blitz/zephyr/soc/efinix/sapphire/Kconfig"
osource "/Users/joshmillar/Desktop/phd/blitz/zephyr/soc/cdns/xtensa_sample_controller/Kconfig"
osource "/Users/joshmillar/Desktop/phd/blitz/zephyr/soc/cdns/dc233c/Kconfig"
osource "/Users/joshmillar/Desktop/phd/blitz/zephyr/soc/brcm/bcmvk/Kconfig"
osource "/Users/joshmillar/Desktop/phd/blitz/zephyr/soc/brcm/bcm2712/Kconfig"
osource "/Users/joshmillar/Desktop/phd/blitz/zephyr/soc/brcm/bcm2711/Kconfig"
osource "/Users/joshmillar/Desktop/phd/blitz/zephyr/soc/atmel/sam0/Kconfig"
osource "/Users/joshmillar/Desktop/phd/blitz/zephyr/soc/atmel/sam/Kconfig"
osource "/Users/joshmillar/Desktop/phd/blitz/zephyr/soc/aspeed/Kconfig"
osource "/Users/joshmillar/Desktop/phd/blitz/zephyr/soc/arm/Kconfig"
osource "/Users/joshmillar/Desktop/phd/blitz/zephyr/soc/arm/beetle/Kconfig"
osource "/Users/joshmillar/Desktop/phd/blitz/zephyr/soc/andestech/Kconfig"
osource "/Users/joshmillar/Desktop/phd/blitz/zephyr/soc/ambiq/Kconfig"
osource "/Users/joshmillar/Desktop/phd/blitz/zephyr/soc/altr/zephyr_nios2f/Kconfig"
osource "/Users/joshmillar/Desktop/phd/blitz/zephyr/soc/altr/qemu_nios2/Kconfig"
osource "/Users/joshmillar/Desktop/phd/blitz/zephyr/soc/adi/max32/Kconfig"
```
